## arch/arm/mach-imx/mx7ulp/Kconfig
```kconfig
if ARCH_MX7ULP

config SYS_SOC
	default "mx7ulp"

config MX7ULP
	bool

config LDO_ENABLED_MODE
	bool "i.MX7ULP LDO Enabled Mode"
	help
	  Select this option to enable the PMC1 LDO.

choice
	prompt "MX7ULP board select"
	optional

config TARGET_MX7ULP_EVK
	bool "Support mx7ulp EVK board"
	select MX7ULP
	select SYS_ARCH_TIMER

config TARGET_MX7ULPEA_UCOM
	bool "Support EA mx7ulp uCOM board"
	select MX7ULP

endchoice

source "board/freescale/mx7ulp_evk/Kconfig"
source "board/embeddedartists/mx7ulpea-ucom/Kconfig"

endif
```
